#include "hope.dtsi"

/* Right side columns should land in the global matrix columns 6..11 */
&default_transform {
    col-offset = <6>;
};

&kscan {
    row-gpios = <
        &gpio0 20 (GPIO_ACTIVE_HIGH | GPIO_PULL_DOWN) /* P0.20 */
        &gpio0 17 (GPIO_ACTIVE_HIGH | GPIO_PULL_DOWN) /* P0.17 */
        &gpio0 22 (GPIO_ACTIVE_HIGH | GPIO_PULL_DOWN) /* P0.22 */
        &gpio0 24 (GPIO_ACTIVE_HIGH | GPIO_PULL_DOWN) /* P0.24 */
        &gpio0 29 (GPIO_ACTIVE_HIGH | GPIO_PULL_DOWN) /* P0.29 */
        &gpio0 31 (GPIO_ACTIVE_HIGH | GPIO_PULL_DOWN) /* P0.31 */
    >;

    col-gpios = <
        &gpio0 2  GPIO_ACTIVE_HIGH  /* P0.02 */
        &gpio1 13 GPIO_ACTIVE_HIGH  /* P1.13 */
        &gpio1 15 GPIO_ACTIVE_HIGH  /* P1.15 */
        &gpio1 11 GPIO_ACTIVE_HIGH  /* P1.11 */
        &gpio0 10 GPIO_ACTIVE_HIGH  /* P0.10 */
        &gpio0 9  GPIO_ACTIVE_HIGH  /* P0.09 */
    >;
};
