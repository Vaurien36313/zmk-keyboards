#include "hope.dtsi"

&kscan {
    row-gpios = <
        &gpio0 20 (GPIO_ACTIVE_HIGH | GPIO_PULL_DOWN) /* P0.20 */
        &gpio0 17 (GPIO_ACTIVE_HIGH | GPIO_PULL_DOWN) /* P0.17 */
        &gpio0 22 (GPIO_ACTIVE_HIGH | GPIO_PULL_DOWN) /* P0.22 */
        &gpio0 24 (GPIO_ACTIVE_HIGH | GPIO_PULL_DOWN) /* P0.24 */
        &gpio0 9  (GPIO_ACTIVE_HIGH | GPIO_PULL_DOWN) /* P0.09 */
        &gpio0 10 (GPIO_ACTIVE_HIGH | GPIO_PULL_DOWN) /* P0.10 */
    >;

    col-gpios = <
        &gpio0 11 GPIO_ACTIVE_HIGH  /* P0.11 */
        &gpio1 0  GPIO_ACTIVE_HIGH  /* P1.00 */
        &gpio1 4  GPIO_ACTIVE_HIGH  /* P1.04 */
        &gpio1 6  GPIO_ACTIVE_HIGH  /* P1.06 */
        &gpio0 29 GPIO_ACTIVE_HIGH  /* P0.29 */
        &gpio0 31 GPIO_ACTIVE_HIGH  /* P0.31 */
    >;
};
