## boards/shields/hope/Kconfig.defconfig
```kconfig
if SHIELD_HOPE_LEFT

config ZMK_KEYBOARD_NAME
    default "manufrom_smart"

config ZMK_SPLIT_ROLE_CENTRAL
    default y

endif # SHIELD_HOPE_LEFT

if SHIELD_HOPE_LEFT || SHIELD_HOPE_RIGHT

config ZMK_SPLIT
    default y

endif # SHIELD_HOPE_LEFT || SHIELD_HOPE_RIGHT
```

## boards/shields/hope/Kconfig.shield
```kconfig
config SHIELD_HOPE_LEFT
    def_bool $(shields_list_contains,hope_left)

config SHIELD_HOPE_RIGHT
    def_bool $(shields_list_contains,hope_right)
```

## config/Kconfig.shield
```kconfig
config SHIELD_ONE_CONTROLLER
    def_bool $(shields_list_contains,one_controller)
```

## config/one_controller/Kconfig.defconfig
```kconfig
if SHIELD_ONE_CONTROLLER

config ZMK_KEYBOARD_NAME
    default "manuform"

endif # SHIELD_ONE_CONTROLLER
```
